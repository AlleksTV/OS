/* ============================================================================
 * linker.ld — СКРИПТ КОМПОНОВЩИКА
 * ============================================================================
 * Компоновщик (ld) собирает объектные файлы (.o) в один исполняемый файл.
 * Обычные программы загружает ОС, которая понимает формат ELF. У нас ОС ещё
 * нет — загрузчик просто копирует байты с диска в память по адресу 0x10000.
 * Поэтому мы должны точно сказать компоновщику:
 *   - по какому адресу будет лежать код (0x10000);
 *   - что первым должен идти код из entry.asm (секция .text.entry).
 * Затем objcopy превращает ELF в "плоский" бинарный файл без заголовков.
 * ==========================================================================*/

ENTRY(_start)

SECTIONS
{
    . = 0x10000;                    /* Ядро начинается с этого адреса */

    .text : {                       /* Машинный код */
        *(.text.entry)              /* _start — строго первым! */
        *(.text*)
    }

    .rodata : {                     /* Константы и строковые литералы */
        *(.rodata*)
    }

    .data : {                       /* Инициализированные глобальные переменные */
        *(.data*)
    }

    .bss : {                        /* Неинициализированные переменные (нули) */
        __bss_start = .;
        *(.bss*)
        *(COMMON)
        __bss_end = .;
    }

    __kernel_end = .;               /* Конец ядра в памяти */

    /DISCARD/ : {                   /* Служебные секции компилятора нам не нужны */
        *(.comment)
        *(.eh_frame)
        *(.note*)
    }
}
